## config/boards/arm/zitaotech_sofle/Kconfig
```kconfig
# Copyright (c) 2025 ZitaoTech
# SPDX-License-Identifier: MIT

config BOARD_ZITAOTECH_SOFLE_LEFT
    bool

config BOARD_ZITAOTECH_SOFLE_RIGHT
    bool

menu "Sofle pointer sensitivity"

config SOFLE_TOUCHPAD_SENSITIVITY_DEFAULT
    int "Touchpad default sensitivity level"
    range 10 100
    default 100
    help
      Independent firmware sensitivity level. 100 preserves the legacy
      touchpad USB startup gain. This is not a hardware DPI value.

config SOFLE_TRACKPOINT_SENSITIVITY_DEFAULT
    int "TrackPoint default sensitivity level"
    range 10 100
    default 40
    help
      Independent firmware sensitivity level. 40 preserves the legacy
      TrackPoint gain at the factory backlight default.

config SOFLE_POINTER_SENSITIVITY_STEP
    int "Sensitivity level change per key press"
    range 1 90
    default 10

endmenu
```

## config/boards/arm/zitaotech_sofle/Kconfig.board
```kconfig
# Copyright (c) 2025 ZitaoTech
# SPDX-License-Identifier: MIT

config BOARD_ZITAOTECH_SOFLE_LEFT
    bool "zitaotech sofle left"
    depends on SOC_NRF52840_QIAA

config BOARD_ZITAOTECH_SOFLE_RIGHT
    bool "zitaotech sofle right"
    depends on SOC_NRF52840_QIAA
```

## config/boards/shields/left_bbtrackpad/Kconfig.shield
```kconfig
# Copyright (c) 2022 The ZMK Contributors
# SPDX-License-Identifier: MIT

config SHIELD_LEFT_BBTRACKPAD
    def_bool $(shields_list_contains,left_bbtrackpad)

if SHIELD_LEFT_BBTRACKPAD

menu "A320 touchpad"

config A320_LOG_LEVEL
    int "Driver log level"
    range 0 4
    default 4

config INPUT_A320_INIT_PRIORITY
    int "Driver initialization priority"
    default 90

config A320_MOUSE_SENS_BASE_PERCENT
    int "Pointer sensitivity base (percent)"
    default 40

config A320_MOUSE_SENS_STEP_PERCENT
    int "Pointer sensitivity gain per level (percent)"
    default 1

config A320_FINGER_PRESENCE
    bool "Report experimental A320 optical contact estimate"
    default y if !SHIELD_SETTINGS_RESET
    help
      Experimental: poll shutter exposure every 100 ms; actual sensor motion
      can advance the next optical sample, but never closer than 20 ms.
      Exposure below 350 estimates contact, above 450 estimates release; the
      dead band keeps the reported state. Contact reports on the first
      qualifying sample. Release waits 500 ms from the first qualifying
      departure and then up to one polling period, so accelerated reads cannot
      shorten the layer grace period. Sensor wake time can add latency. Motion
      does not determine contact. Thresholds and battery impact require testing.

config A320_FPD_DIAGNOSTICS
    bool "Log A320 contact diagnostic registers"
    depends on A320_FINGER_PRESENCE && ZMK_USB_LOGGING
    default n
    help
      Temporary opt-in diagnostics: log raw status, optics, sensor mode,
      and FPD configuration at most twice per second. No key contents.
      Adds read traffic; disable after diagnosis. Keep ZMK logging minimal
      so unrelated keyboard debug messages are not collected.

config TOUCHPAD_PAIRING_LAMP_BRIGHTNESS
    int "New-pairing breathing peak brightness (percent)"
    range 1 100
    default 20
    help
      Independent of keyboard backlight and pointer sensitivity.

endmenu

endif # SHIELD_LEFT_BBTRACKPAD
```

## config/dts/bindings/behaviors/zitaotech,behavior-keyboard-backlight.yaml
```yaml
# SPDX-License-Identifier: MIT

description: Control real Sofle PWM keyboard backlight independently of other lights

compatible: "zitaotech,behavior-keyboard-backlight"

include: one_param.yaml
```

## config/dts/bindings/behaviors/zitaotech,behavior-pointing-sensitivity.yaml
```yaml
# SPDX-License-Identifier: MIT

description: Adjust each half's independent pointer sensitivity level

compatible: "zitaotech,behavior-pointing-sensitivity"

include: one_param.yaml
```

## config/dts/bindings/behaviors/zitaotech,behavior-scroll-step.yaml
```yaml
# SPDX-License-Identifier: MIT
description: Send one immediate vertical or horizontal mouse wheel increment
compatible: "zitaotech,behavior-scroll-step"
include: one_param.yaml
```
